## main/Kconfig.projbuild
```kconfig
menu "SF64 virtual controls"
    config SF64_TOUCH_SWAP_XY
        bool "Swap touch X/Y axes"
        default n
    config SF64_TOUCH_MIRROR_X
        bool "Mirror touch X axis"
        default n
    config SF64_TOUCH_MIRROR_Y
        bool "Mirror touch Y axis"
        default n
endmenu

config SF64_STARSHIP_RUNTIME
    bool "Execute original Starship game runtime (development)"
    default n
```

## sdkconfig.defaults
```kconfig
CONFIG_IDF_TARGET="esp32p4"
CONFIG_ESPTOOLPY_FLASHSIZE_16MB=y
CONFIG_SPIRAM=y
CONFIG_SPIRAM_SPEED_200M=y
CONFIG_SPIRAM_MEMTEST=y
CONFIG_PARTITION_TABLE_CUSTOM=y
CONFIG_PARTITION_TABLE_CUSTOM_FILENAME="partitions.csv"
CONFIG_COMPILER_OPTIMIZATION_PERF=y
CONFIG_ESP_MAIN_TASK_STACK_SIZE=16384
```
